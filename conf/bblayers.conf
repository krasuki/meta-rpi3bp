## conf/bblayers.conf
```bitbake
# POKY_BBLAYERS_CONF_VERSION is increased each time build/conf/bblayers.conf
# changes incompatibly
POKY_BBLAYERS_CONF_VERSION = "2"

BBPATH = "${TOPDIR}"
BBFILES ?= ""
META_DIR = "${TOPDIR}/../sources"

BBLAYERS ?= " \
  ${META_DIR}/../../../meta-rpi3bp \
  ${META_DIR}/poky/meta \
  ${META_DIR}/poky/meta-poky \
  ${META_DIR}/poky/meta-yocto-bsp \
  ${META_DIR}/meta-openembedded/meta-oe \
  ${META_DIR}/meta-openembedded/meta-multimedia \
  ${META_DIR}/meta-openembedded/meta-networking \
  ${META_DIR}/meta-openembedded/meta-python \ 
  ${META_DIR}/meta-qt5 \
  ${META_DIR}/meta-raspberrypi \
  "

BBLAYERS_NON_REMOVABLE ?= " \
  ${META_DIR}/poky/meta \
  ${META_DIR}/poky/meta-poky \
  "
```

## conf/distro/kvision-distro.conf
```bitbake
# Custom distro for centralp evision BSP

# Derivate from poky
require conf/distro/poky.conf

DISTRO_NAME = "kvision distro (Specific distro for kvision)"

DISTROOVERRIDES = "poky:kvision:kvision-distro"

# Add systemd as feature
DISTRO_FEATURES_append = " systemd "

# Tweak sw features of the distro:
# - Framebuffer as video backend
# - No package tests in image
# - No bluetooth
# - No pci
# - No 3g
# - No NFC
# - No irda
# - No avahi (zeroconf)
# - No pulseaudio (only alsa)
# - No wifi
DISTRO_FEATURES_remove = " \
            x11 wayland \
            ptest \
            bluetooth bluez5 \
            pci 3g nfc irda \
            zeroconf \
            pulseaudio \
            sysvinit \
            wifi \
            "

# Select systemd as init manager
VIRTUAL-RUNTIME_init_manager = "systemd"

MACHINE_EXTRA_RRECOMMENDS += "udev-rules-kvision"
```

## conf/distro/rpi3bp-distro.conf
```bitbake
# Custom distro for Raspberry Pi 3B+

# Derivate from poky
require conf/distro/poky.conf

DISTRO_NAME = "rpi3bp distro (Yocto Custom)"

DISTROOVERRIDES = "poky:rpi3bp:${DISTRO}"

DISTRO_FEATURES_append = " systemd "

# to build for EGLFS (ie no window system)
DISTRO_FEATURES_remove = " \
    x11 \
    wayland \
    "


VIRTUAL-RUNTIME_init_manager = "systemd"
```

## conf/layer.conf
```bitbake
# We have a conf and classes directory, add to BBPATH
BBPATH .= ":${LAYERDIR}"

# We have recipes-* directories, add to BBFILES
BBFILES += "${LAYERDIR}/recipes-*/*/*.bb \
	${LAYERDIR}/recipes-*/*/*.bbappend"

BBFILE_COLLECTIONS += "meta-rpi3bp"
BBFILE_PATTERN_meta-rpi3bp = "^${LAYERDIR}/"
BBFILE_PRIORITY_meta-rpi3bp = "23"
#LAYERDEPENDS_meta-rpi3bp = "meta-raspberrypi" 

LAYERSERIES_COMPAT_meta-rpi3bp = "warrior"
```

## conf/machine/kvision.conf
```bitbake
#@TYPE: Machine
#@NAME: evision+
#@SOC: i.MX6q
#@DESCRIPTION: Machine configuration for Centralp iMX6q target

MACHINEOVERRIDES =. "mx6:mx6q:"

# Sets a set of good defaults for imx
require conf/machine/include/imx-base.inc
require conf/machine/include/tune-cortexa9.inc

SERIAL_CONSOLE = "115200 ttymxc3"

PREFERRED_PROVIDER_virtual/kernel = "linux-imx"
KERNEL_DEVICETREE = "imx6q-kvision.dtb"
KERNEL_IMAGETYPE = "uImage"
KERNEL_EXTRA_FEATURES ?= "features/overlayfs/overlayfs.scc"

#EXTRA_IMAGEDEPENDS += "u-boot-imx"
PREFERRED_PROVIDER_virtual/bootloader = "u-boot-imx"
UBOOT_MACHINE = "mx6qkvision_config"

# FIXME Add useful firmware here
# MACHINE_FIRMWARE_append_mx6 = " "

# FIXME wifi/BT features to be added ?
# MACHINE_FEATURES += " "

# Vivante GPU driver is provided by kernel and built-in
# (These vars are used by fsl-vivante-kernel-driver-handler class)
MACHINE_HAS_VIVANTE_KERNEL_DRIVER_SUPPORT = "1"
MACHINE_USES_VIVANTE_KERNEL_DRIVER_MODULE = "0"

IMAGE_FSTYPES = "tar.gz"
MACHINE_EXTRA_RRECOMMENDS += "kernel-modules"

PREFERRED_VERSION_imx-gpu-viv = "6.2.2.p0-aarch32"
PREFERRED_VERSION_tslib = "1.19"
```

## conf/machine/rpi3bp.conf
```bitbake
#@TYPE: Machine
#@NAME: Raspberry Pi 3B+
#@SOC: BCM2835
#@DESCRIPTION: Machine configuration for Raspberry Pi 3B+ target

MACHINEOVERRIDES =. "raspberrypi3-64:${MACHINE}"

require conf/machine/raspberry3-64.conf

SERIAL_CONSOLES = "115200;tty1"

RPI_KERNEL_DEVICETREE = "broadcom/bcm2710-rpi-3-b-plus.dtb"

RPI_USE_U_BOOT = "1"
```
